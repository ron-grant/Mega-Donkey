/*  MegaDonkey Library File:  vchar.c   Vector Character Support 
    


    Copyright 2007,2008  Mark Sims & Ron Grant


    This file is part of The Megadonkey Software Library.

    The Megadonkey Software Library is free software: you can redistribute it and/or modify
    it under the terms of the GNU Lesser General Public License as published by
    the Free Software Foundation, either version 3 of the License, or
    (at your option) any later version.

    The Megadonkey Software Library is distributed in the hope that it will be useful,
    but WITHOUT ANY WARRANTY; without even the implied warranty of MERCHANTABILITY or
    FITNESS FOR A PARTICULAR PURPOSE.  See the GNU Lesser General Public License for
    more details.

    You should have received a copy of the GNU Lesser General Public License
    along with the Megadonkey Software Library. If not, see <http://www.gnu.org/licenses/>.



  vchar.c   Megadonkey Vector Character Set Support

  Ron Grant
  April 18, 2007

  03 May 2007 - 16 bit coords & using clipped_line  
  25 May 2007 - modified text/printf routines for greater compatibility
                with bitmapped text routines - Mark Sims
  01 Sep 2008 - Major redo to support the full character set and arbitary
                character sizes.  Added character rotations and slant.

*/


#include <avr/pgmspace.h>  // support for vars stored in prog mem 
                           // including vector character table
#include <stdio.h>
#include <ctype.h>
#include "md.h"

#ifdef VCHAR_CODE
#include "lcd.h"
#include "timer.h"
#include "adc.h"
#include "vchar.h"
#include "graph.h"   // 2D line clipper
#include "trakball.h"

//
// Vector Character Table
// This table remains in program memory (PROGMEM) and requires special 
// function calls to access.
//
// Each byte in a stroke list contains a pair of coordinate offsets 
// and two flag bits.
//   LINE:COL:EOL:ROW    (LINE:1 bit  COL:3 bits    EOL:1 bit ROW:3 bits)
// If the LINE bit is 0,  then move to the new coordinate and draw a dot.
// If the LINE bit is 1,  draw a line from the current coordinate to the new
//                        coordinate.
// If the EOL bit is set, the byte is the last one in the stroke list.
// A 0xFF byte indicates a null character (or end of the stroke list).
//
char vg_00[] PROGMEM = { 0xFF };
char vg_01[] PROGMEM = { 0x01,0x90,0xD0,0xE1,0xE6, 0x01,0x86,0x97,0xD7,0xE6, 0x22,
                         0x24,0xB5,0xC4, 0x4A };
char vg_02[] PROGMEM = { 0x01,0x90,0xC3, 0x01,0xE1,0xE6, 0x01,0x86,0x97,0xD7,0xE6,
                         0x02,0xA0,0xB1,0xC0,0xE2, 0x03,0xE3, 0x04,0xB7,0xE4, 0x05,0xA7,
                         0x05,0x95,0x97, 0x06,0xE6, 0x10,0xD0,0xE1, 0x10,0x91, 0x20,0xA1,0xB0,0xC1,
                         0x23,0xD0,0xD1, 0x26,0xA7, 0x30,0xB3, 0x36,0xB7, 0x40,0xC1,
                         0x46,0xC7,0xE5, 0x55,0xE5, 0x55,0xDF };
char vg_03[] PROGMEM = { 0x01,0x90,0xC3, 0x01,0xB4, 0x01,0xC1,0xC3, 0x01,0x83,0xA5,0xC3,
                         0x02,0xA4,0xC2, 0x02,0xC2, 0x03,0xB0,0xC1, 0x03,0xC3, 0x10,0x94,0xC1,
                         0x11,0xB3, 0x13,0xB1, 0x14,0xB4, 0x21,0xA6, 0x30,0xBC };
char vg_04[] PROGMEM = { 0x03,0xB6,0xE3, 0x03,0xB0,0xE3, 0x03,0xE3, 0x12,0xC5, 0x12,0xD2,0xD4,
                         0x12,0x94,0xC1,0xC5, 0x13,0xB5,0xD3, 0x13,0xB1,0xD3, 0x14,0xD4,
                         0x21,0xD4, 0x21,0xC1, 0x21,0xA5,0xD2, 0x22,0xC4, 0x24,0xC2,
                         0x25,0xC5, 0x30,0xBE };
char vg_05[] PROGMEM = { 0x03,0xC7, 0x03,0xD3,0xD4, 0x03,0x84,0xB7, 0x04,0xB1, 0x04,0xD4,
                         0x11,0xA0,0xB1, 0x11,0xC4, 0x11,0xC1, 0x13,0xB5, 0x13,0x95,0xB3,
                         0x14,0xC1, 0x15,0xC5, 0x17,0xD3, 0x17,0xC7, 0x20,0xB0,0xC1,
                         0x20,0xA7,0xD4, 0x21,0xB0,0xB7, 0x21,0xD4, 0x22,0xB2, 0x23,0xC5,
                         0x25,0xC3,0xC5, 0x26,0xBE };
char vg_06[] PROGMEM = { 0x03,0xC7, 0x03,0xB0,0xE3,0xE5, 0x03,0xE3, 0x03,0x85,0xC1,0xC5,
                         0x04,0xB1,0xE4, 0x04,0xE4, 0x12,0xC5, 0x12,0xD2,0xD4, 0x12,0x94,
                         0x13,0xB5,0xD3, 0x21,0xE5, 0x21,0xC1, 0x21,0xA5,0xD2, 0x22,0xC4,
                         0x24,0xC2, 0x25,0xC5, 0x27,0xE3, 0x27,0xC7, 0x30,0xBF };
char vg_07[] PROGMEM = { 0x23,0xB4,0xC3,0xC4, 0x23,0xB2,0xC3, 0x23,0xC3, 0x23,0xA4,0xB3,0xC4,
                         0x24,0xB5,0xC4, 0x24,0xC4, 0x32,0xBD };
char vg_08[] PROGMEM = { 0x00,0xE0,0xE7, 0x00,0x87,0xE7, 0x01,0x90,0x92, 0x01,0xE1,
                         0x02,0xA0,0xA1, 0x02,0x92, 0x03,0xB0,0xE3, 0x04,0xB7,0xE4,
                         0x05,0xA7, 0x05,0x95,0x97, 0x06,0x97, 0x06,0xE6, 0x26,0xA7,
                         0x30,0xB1, 0x36,0xB7, 0x40,0xE2, 0x40,0xC1, 0x46,0xC7,0xE5,
                         0x50,0xE1, 0x50,0xD2,0xE2, 0x55,0xE5, 0x55,0xD7,0xEE };
char vg_09[] PROGMEM = { 0x03,0xA1,0xC1,0xE3,0xE4, 0x03,0x84,0xA6,0xC6,0xEC };
char vg_0A[] PROGMEM = { 0x00,0xE0,0xE7, 0x00,0x87,0xE7, 0x23,0xB4,0xC3,0xC4, 0x23,0xB2,0xC3,
                         0x23,0xC3, 0x23,0xA4,0xB3,0xC4, 0x24,0xB5,0xC4, 0x24,0xC4,
                         0x32,0xBD };
char vg_0B[] PROGMEM = { 0x04,0x93,0xB3,0xC4,0xC6, 0x04,0x86,0x97,0xB7,0xC6, 0x33,0xE0,0xE2,
                         0x40,0xE8 };
char vg_0C[] PROGMEM = { 0x11,0xA0,0xC0,0xD1,0xD3, 0x11,0x93,0xA4,0xC4,0xD3, 0x16,0xD6,
                         0x34,0xBF };
char vg_0D[] PROGMEM = { 0x06,0x95,0xA5, 0x06,0x87,0x97,0xA6, 0x20,0xE0,0xE2, 0x20,0xA6,
                         0x22,0xEA };
char vg_0E[] PROGMEM = { 0x05,0x94,0xA4, 0x05,0x86,0x96,0xA5, 0x20,0xE0,0xE6, 0x20,0xA5,
                         0x22,0xE2, 0x46,0xD5,0xE5, 0x46,0xC7,0xD7,0xEE };
char vg_0F[] PROGMEM = { 0x00,0xA2, 0x03,0x93,0xB5,0xD3,0xE3, 0x06,0xA4, 0x13,0xB1,0xD3,
                         0x30,0xB1, 0x35,0xB6, 0x42,0xE0, 0x44,0xEE };
char vg_10[] PROGMEM = { 0x00,0xB3, 0x00,0x86,0xB3, 0x01,0xA3, 0x01,0x91,0x95, 0x02,0xA4,
                         0x02,0xA2,0xA4, 0x03,0xB3, 0x04,0xA2, 0x04,0xA4, 0x05,0xA3,
                         0x05,0x9D };
char vg_11[] PROGMEM = { 0x23,0xD6, 0x23,0xD0,0xD6, 0x23,0xD3, 0x32,0xD4, 0x32,0xD2,
                         0x32,0xB4,0xD2, 0x33,0xD5, 0x33,0xD1, 0x34,0xD4, 0x41,0xD1,
                         0x41,0xC5,0xDD };
char vg_12[] PROGMEM = { 0x12,0xB0,0xD2, 0x15,0xB7,0xD5, 0x30,0xBF };
char vg_13[] PROGMEM = { 0x10,0x94, 0x16, 0x50,0xD4, 0x5E };
char vg_14[] PROGMEM = { 0x01,0x90,0xE0,0xE6, 0x01,0x82,0x93,0xB3, 0x30,0xBE };
char vg_15[] PROGMEM = { 0x06,0x97,0xB7,0xC6, 0x11,0xA2,0xB2,0xC3,0xC4, 0x11,0xA0,0xC0,0xD1,
                         0x13,0xA2, 0x13,0x94,0xA5,0xB5,0xC6, 0x35,0xCC };
char vg_16[] PROGMEM = { 0x14,0xB6,0xD4,0xD6, 0x14,0xD4, 0x14,0x96,0xB4,0xD6, 0x15,0xA6,0xC4,0xD5,
                         0x15,0xA4,0xC6,0xD5, 0x15,0xD5, 0x16,0xD6, 0x24,0xA6, 0x34,0xB6,
                         0x44,0xCE };
char vg_17[] PROGMEM = { 0x12,0xB0,0xD2, 0x14,0xB6,0xD4, 0x17,0xD7, 0x30,0xBE };
char vg_18[] PROGMEM = { 0x12,0xB0,0xD2, 0x30,0xBE };
char vg_19[] PROGMEM = { 0x14,0xB6,0xD4, 0x30,0xBE };
char vg_1A[] PROGMEM = { 0x03,0xD3, 0x31,0xD3, 0x35,0xDB };
char vg_1B[] PROGMEM = { 0x03,0xA5, 0x03,0xA1, 0x03,0xDB };
char vg_1C[] PROGMEM = { 0x02,0x85,0xDD };
char vg_1D[] PROGMEM = { 0x03,0xA5, 0x03,0xA1, 0x03,0xE3, 0x41,0xE3, 0x45,0xEB };
char vg_1E[] PROGMEM = { 0x04,0xB1,0xE4, 0x04,0xE4, 0x13,0xD3,0xD4, 0x13,0x94,0xB2,0xD4,
                         0x22,0xC4, 0x22,0xC2,0xC4, 0x22,0xA4,0xC2, 0x31,0xBC };
char vg_1F[] PROGMEM = { 0x02,0xB5,0xE2, 0x02,0xE2, 0x12,0xB4,0xD2,0xD3, 0x12,0x93,0xD3,
                         0x22,0xC4, 0x22,0xA4,0xC2,0xC4, 0x24,0xC4, 0x32,0xBD };
char vg_20[] PROGMEM = { 0xFF };
char vg_21[] PROGMEM = { 0x11,0xA0,0xB1,0xB3, 0x11,0xB3, 0x11,0xB1, 0x11,0x93,0xA4,0xB3,
                         0x12,0xB2, 0x13,0xB1, 0x13,0xB3, 0x20,0xA4, 0x2E };
char vg_22[] PROGMEM = { 0x10,0x92, 0x40,0xCA };
char vg_23[] PROGMEM = { 0x02,0xD2, 0x04,0xD4, 0x10,0x96, 0x40,0xCE };
char vg_24[] PROGMEM = { 0x02,0x93,0xB3,0xC4, 0x02,0x91,0xC1, 0x05,0xB5,0xC4, 0x20,0xA1,
                         0x25,0xAE };
char vg_25[] PROGMEM = { 0x01,0x91,0x92, 0x01,0x82,0x92, 0x06,0xD1, 0x45,0xD5,0xD6,
                         0x45,0xC6,0xDE };
char vg_26[] PROGMEM = { 0x04,0xA2,0xB2,0xD4,0xE3, 0x04,0x85,0x96,0xC6,0xD5,0xE6,
                         0x11,0xA2, 0x11,0xA0,0xB0,0xC1, 0x32,0xC1, 0x54,0xDD };
char vg_27[] PROGMEM = { 0x02,0x91, 0x10,0x99 };
char vg_28[] PROGMEM = { 0x12,0xB0, 0x12,0x94,0xBE };
char vg_29[] PROGMEM = { 0x10,0xB2,0xB4, 0x16,0xBC };
char vg_2A[] PROGMEM = { 0x03,0xE3, 0x11,0xD5, 0x15,0xD1, 0x30,0xBE };
char vg_2B[] PROGMEM = { 0x03,0xC3, 0x21,0xAD };
char vg_2C[] PROGMEM = { 0x17,0xA6, 0x25,0xAE };
char vg_2D[] PROGMEM = { 0x03,0xCB };
char vg_2E[] PROGMEM = { 0x25,0xAE };
char vg_2F[] PROGMEM = { 0x05,0xD8 };
char vg_30[] PROGMEM = { 0x01,0x90,0xC0,0xD1,0xD5, 0x01,0x85,0x96,0xC6,0xD5, 0x05,0xD9 };
char vg_31[] PROGMEM = { 0x11,0xA0,0xA6, 0x16,0xBE };
char vg_32[] PROGMEM = { 0x01,0x90,0xB0,0xC1,0xC2, 0x05,0xA3,0xB3,0xC2, 0x05,0x86,0xCE };
char vg_33[] PROGMEM = { 0x01,0x90,0xB0,0xC1,0xC2, 0x05,0x96,0xB6,0xC5, 0x23,0xB3,0xC4,0xC5,
                         0x33,0xCA };
char vg_34[] PROGMEM = { 0x03,0xB0,0xC0,0xC6, 0x03,0x84,0xDC };
char vg_35[] PROGMEM = { 0x00,0xC0, 0x00,0x82,0xB2,0xC3,0xC5, 0x05,0x96,0xB6,0xCD };
char vg_36[] PROGMEM = { 0x02,0xA0,0xB0, 0x02,0x85,0x96,0xB6,0xC5, 0x03,0xB3,0xC4,0xCD };
char vg_37[] PROGMEM = { 0x00,0xC0,0xC2, 0x00,0x81, 0x24,0xC2, 0x24,0xAE };
char vg_38[] PROGMEM = { 0x01,0x90,0xB0,0xC1,0xC2, 0x01,0x82,0x93,0xB3,0xC4,0xC5,
                         0x04,0x93, 0x04,0x85,0x96,0xB6,0xC5, 0x33,0xCA };
char vg_39[] PROGMEM = { 0x01,0x90,0xB0,0xC1,0xC4, 0x01,0x82,0x93,0xC3, 0x16,0xA6,0xCC };
char vg_3A[] PROGMEM = { 0x21,0xA2, 0x25,0xAE };
char vg_3B[] PROGMEM = { 0x17,0xA6, 0x21,0xA2, 0x25,0xAE };
char vg_3C[] PROGMEM = { 0x03,0xB6, 0x03,0xB8 };
char vg_3D[] PROGMEM = { 0x02,0xC2, 0x05,0xCD };
char vg_3E[] PROGMEM = { 0x10,0xC3, 0x16,0xCB };
char vg_3F[] PROGMEM = { 0x01,0x90,0xB0,0xC1,0xC2, 0x24,0xC2, 0x24,0xA5, 0x2F };
char vg_40[] PROGMEM = { 0x01,0x90,0xC0,0xD1,0xD4, 0x01,0x85,0x96,0xB6, 0x32,0xB4,0xDC };
char vg_41[] PROGMEM = { 0x02,0xA0,0xC2,0xC6, 0x02,0x86, 0x04,0xCC };
char vg_42[] PROGMEM = { 0x00,0xB0,0xC1,0xC2, 0x00,0x86,0xB6,0xC5, 0x03,0xB3,0xC4,0xC5,
                         0x33,0xCA };
char vg_43[] PROGMEM = { 0x02,0xA0,0xC0,0xD1, 0x02,0x84,0xA6,0xC6,0xDD };
char vg_44[] PROGMEM = { 0x00,0xA0,0xC2,0xC4, 0x00,0x86,0xA6,0xCC };
char vg_45[] PROGMEM = { 0x10,0xD0, 0x10,0x96,0xD6, 0x13,0xBB };
char vg_46[] PROGMEM = { 0x10,0xD0, 0x10,0x96, 0x13,0xBB };
char vg_47[] PROGMEM = { 0x02,0xA0,0xC0,0xD1, 0x02,0x84,0xA6,0xD6, 0x44,0xD4,0xDE };
char vg_48[] PROGMEM = { 0x00,0x86, 0x03,0xC3, 0x40,0xCE };
char vg_49[] PROGMEM = { 0x10,0xB0, 0x16,0xB6, 0x20,0xAE };
char vg_4A[] PROGMEM = { 0x04,0x85,0x96,0xB6,0xC5, 0x30,0xD0, 0x40,0xCD };
char vg_4B[] PROGMEM = { 0x00,0x86, 0x03,0xA3,0xC5,0xC6, 0x23,0xC1, 0x40,0xC9 };
char vg_4C[] PROGMEM = { 0x10,0x96,0xDE };
char vg_4D[] PROGMEM = { 0x00,0xB3,0xE0,0xE6, 0x00,0x86, 0x33,0xBC };
char vg_4E[] PROGMEM = { 0x00,0xD5, 0x00,0x86, 0x50,0xDE };
char vg_4F[] PROGMEM = { 0x02,0xA0,0xB0,0xD2,0xD4, 0x02,0x84,0xA6,0xB6,0xDC };
char vg_50[] PROGMEM = { 0x10,0xC0,0xD1,0xD2, 0x10,0x96, 0x13,0xC3,0xDA };
char vg_51[] PROGMEM = { 0x01,0x90,0xB0,0xC1,0xC5, 0x01,0x85,0x96,0xB6,0xC5, 0x24,0xDF };
char vg_52[] PROGMEM = { 0x10,0xC0,0xD1,0xD2, 0x10,0x96, 0x13,0xC3,0xD2, 0x33,0xD5,0xDE };
char vg_53[] PROGMEM = { 0x01,0x90,0xB0,0xC1, 0x01,0x82,0x93,0xB3,0xC4,0xC5, 0x05,0x96,0xB6,0xCD };
char vg_54[] PROGMEM = { 0x00,0xC0, 0x20,0xAE };
char vg_55[] PROGMEM = { 0x00,0x85,0x96,0xB6,0xC5, 0x40,0xCD };
char vg_56[] PROGMEM = { 0x00,0x84,0xA6,0xC4, 0x40,0xCC };
char vg_57[] PROGMEM = { 0x00,0x86,0xB3,0xE6, 0x32,0xB3, 0x60,0xEE };
char vg_58[] PROGMEM = { 0x00,0x81,0xD6, 0x06,0xD1, 0x50,0xD9 };
char vg_59[] PROGMEM = { 0x00,0x82,0xA4,0xC2, 0x16,0xB6, 0x24,0xA6, 0x40,0xCA };
char vg_5A[] PROGMEM = { 0x10,0xD0,0xD1, 0x15,0xD1, 0x15,0x96,0xDE };
char vg_5B[] PROGMEM = { 0x10,0xB0, 0x10,0x96,0xBE };
char vg_5C[] PROGMEM = { 0x00,0xEE };
char vg_5D[] PROGMEM = { 0x10,0xB0,0xB6, 0x16,0xBE };
char vg_5E[] PROGMEM = { 0x03,0xB0,0xEB };
char vg_5F[] PROGMEM = { 0x07,0xEF };
char vg_60[] PROGMEM = { 0x20,0xA1,0xBA };
char vg_61[] PROGMEM = { 0x05,0x96,0xB6,0xC5,0xD6, 0x05,0x94,0xC4, 0x12,0xB2,0xC3,0xCD };
char vg_62[] PROGMEM = { 0x06,0x95,0xA6,0xC6,0xD5, 0x10,0x95, 0x13,0xC3,0xD4,0xDD };
char vg_63[] PROGMEM = { 0x03,0x92,0xB2,0xC3, 0x03,0x85,0x96,0xB6,0xCD };
char vg_64[] PROGMEM = { 0x04,0x93,0xC3, 0x04,0x85,0x96,0xB6,0xC5,0xD6, 0x40,0xCD };
char vg_65[] PROGMEM = { 0x03,0x92,0xB2,0xC3,0xC4, 0x03,0x85,0x96,0xB6, 0x04,0xCC };
char vg_66[] PROGMEM = { 0x03,0xA3, 0x06,0xA6, 0x11,0xA0,0xB0,0xC1, 0x11,0x9E };
char vg_67[] PROGMEM = { 0x03,0x92,0xB2,0xC3,0xD2, 0x03,0x84,0x95,0xC5, 0x07,0xB7,0xC6,
                         0x43,0xCE };
char vg_68[] PROGMEM = { 0x10,0x96, 0x14,0xB2,0xC2,0xD3,0xDE };
char vg_69[] PROGMEM = { 0x12,0xA2,0xA6, 0x16,0xB6, 0x28 };
char vg_6A[] PROGMEM = { 0x05,0x86,0x97,0xB7,0xC6, 0x40, 0x42,0xCE };
char vg_6B[] PROGMEM = { 0x10,0x96, 0x14,0xB4,0xD6, 0x34,0xDA };
char vg_6C[] PROGMEM = { 0x10,0xA0,0xA6, 0x16,0xBE };
char vg_6D[] PROGMEM = { 0x02,0x86, 0x04,0xA2,0xB3,0xC2,0xD3,0xD6, 0x33,0xBD };
char vg_6E[] PROGMEM = { 0x02,0x86, 0x04,0xA2,0xB2,0xC3,0xCE };
char vg_6F[] PROGMEM = { 0x03,0x92,0xB2,0xC3,0xC5, 0x03,0x85,0x96,0xB6,0xCD };
char vg_70[] PROGMEM = { 0x02,0x93,0xA2,0xC2,0xD3,0xD4, 0x07,0xA7, 0x13,0x97, 0x15,0xC5,0xDC };
char vg_71[] PROGMEM = { 0x03,0x92,0xB2,0xC3,0xD2, 0x03,0x84,0x95,0xC5, 0x37,0xD7,
                         0x43,0xCF };
char vg_72[] PROGMEM = { 0x02,0x93,0xA2,0xB2,0xC3, 0x06,0xA6, 0x13,0x9E };
char vg_73[] PROGMEM = { 0x03,0x94,0xB4,0xC5, 0x03,0x92,0xC2, 0x06,0xB6,0xCD };
char vg_74[] PROGMEM = { 0x12,0xC2, 0x20,0xA5,0xB6,0xCD };
char vg_75[] PROGMEM = { 0x02,0x85,0x96,0xB6,0xC5,0xD6, 0x42,0xCD };
char vg_76[] PROGMEM = { 0x02,0x84,0xA6,0xC4, 0x42,0xCC };
char vg_77[] PROGMEM = { 0x02,0x85,0x96,0xB4,0xD6,0xE5, 0x33,0xB4, 0x62,0xED };
char vg_78[] PROGMEM = { 0x02,0xA4,0xB4,0xD6, 0x06,0xA4, 0x34,0xDA };
char vg_79[] PROGMEM = { 0x02,0x84,0x95,0xC5, 0x07,0xB7,0xC6, 0x42,0xCE };
char vg_7A[] PROGMEM = { 0x02,0xC2, 0x06,0xC2, 0x06,0xCE };
char vg_7B[] PROGMEM = { 0x03,0x93,0xA4,0xA5,0xB6,0xC6, 0x13,0xA2, 0x21,0xB0,0xC0,
                         0x21,0xAA };
char vg_7C[] PROGMEM = { 0x30,0xB2, 0x34,0xBE };
char vg_7D[] PROGMEM = { 0x00,0x90,0xA1,0xA2,0xB3,0xC3, 0x06,0x96,0xA5, 0x24,0xB3,
                         0x24,0xAD };
char vg_7E[] PROGMEM = { 0x01,0x90,0xA0,0xB1,0xC1,0xD8 };
char vg_7F[] PROGMEM = { 0x04,0xB1,0xE4,0xE6, 0x04,0x86,0xEE };
char vg_80[] PROGMEM = { 0x01,0x90,0xC0,0xD1, 0x01,0x83,0x94,0xC4,0xD3, 0x27,0xC7,0xD6,
                         0x34,0xDE };
char vg_81[] PROGMEM = { 0x01, 0x03,0x85,0x96,0xB6,0xC5,0xD6, 0x41, 0x43,0xCD };
char vg_82[] PROGMEM = { 0x03,0x92,0xB2,0xC3,0xC4, 0x03,0x85,0x96,0xB6, 0x04,0xC4,
                         0x30,0xC8 };
char vg_83[] PROGMEM = { 0x01,0x90,0xD0,0xE1, 0x15,0xA6,0xC6,0xD5,0xE6, 0x15,0xA4,0xD4,
                         0x22,0xC2,0xD3,0xDD };
char vg_84[] PROGMEM = { 0x05,0x96,0xB6,0xC5,0xD6, 0x05,0x94,0xC4, 0x10, 0x12,0xB2,0xC3,0xC5, 0x48 };
char vg_85[] PROGMEM = { 0x00,0x90, 0x05,0x96,0xB6,0xC5,0xD6, 0x05,0x94,0xC4, 0x12,0xB2,0xC3,0xCD };
char vg_86[] PROGMEM = { 0x05,0x96,0xB6,0xC5,0xD6, 0x05,0x94,0xC4, 0x12,0xB2,0xC3,0xC5,
                         0x20,0xB0,0xB1, 0x20,0xA1,0xB9 };
char vg_87[] PROGMEM = { 0x03,0x92,0xC2,0xD3, 0x03,0x84,0x95,0xC5, 0x07,0x97,0xBD };
char vg_88[] PROGMEM = { 0x01,0x90,0xD0,0xE1, 0x13,0xA2,0xC2,0xD3,0xD4, 0x13,0x95,0xA6,0xC6,
                         0x14,0xDC };
char vg_89[] PROGMEM = { 0x00, 0x03,0x92,0xB2,0xC3,0xC4, 0x03,0x85,0x96,0xB6, 0x04,0xC4, 0x48 };
char vg_8A[] PROGMEM = { 0x00,0xA0, 0x03,0x92,0xB2,0xC3,0xC4, 0x03,0x85,0x96,0xB6,
                         0x04,0xCC };
char vg_8B[] PROGMEM = { 0x00, 0x12,0xA2,0xA6, 0x16,0xB6, 0x48 };
char vg_8C[] PROGMEM = { 0x01,0x90,0xC0,0xD1, 0x22,0xB2,0xB6, 0x26,0xCE };
char vg_8D[] PROGMEM = { 0x00,0xA0, 0x12,0xA2,0xA6, 0x16,0xBE };
char vg_8E[] PROGMEM = { 0x00, 0x03,0xA1,0xC3,0xC6, 0x03,0x86, 0x04,0xC4, 0x48 };
char vg_8F[] PROGMEM = { 0x04,0x93,0xB3,0xC4,0xC6, 0x04,0x86, 0x05,0xC5, 0x20,0xB0,0xB1,
                         0x20,0xA1,0xB9 };
char vg_90[] PROGMEM = { 0x12,0xC2, 0x12,0x96,0xC6, 0x14,0xB4, 0x20,0xC8 };
char vg_91[] PROGMEM = { 0x15,0xA4,0xE4, 0x15,0x96,0xE6, 0x22,0xE2, 0x42,0xCE };
char vg_92[] PROGMEM = { 0x02,0xA0,0xE0, 0x02,0x86, 0x03,0xD3, 0x30,0xB6,0xEE };
char vg_93[] PROGMEM = { 0x01,0x90,0xB0,0xC1, 0x04,0x93,0xB3,0xC4,0xC5, 0x04,0x85,0x96,0xB6,0xCD };
char vg_94[] PROGMEM = { 0x01, 0x04,0x93,0xB3,0xC4,0xC5, 0x04,0x85,0x96,0xB6,0xC5, 0x49 };
char vg_95[] PROGMEM = { 0x01,0xA1, 0x04,0x93,0xB3,0xC4,0xC5, 0x04,0x85,0x96,0xB6,0xCD };
char vg_96[] PROGMEM = { 0x01,0x90,0xB0,0xC1, 0x03,0x85,0x96,0xB6,0xC5,0xD6, 0x43,0xCD };
char vg_97[] PROGMEM = { 0x01,0xA1, 0x03,0x85,0x96,0xB6,0xC5,0xD6, 0x43,0xCD };
char vg_98[] PROGMEM = { 0x01, 0x03,0x84,0x95,0xC5, 0x07,0xB7,0xC6, 0x41, 0x43,0xCE };
char vg_99[] PROGMEM = { 0x00, 0x13,0xB1,0xD3,0xD4, 0x13,0x94,0xB6,0xD4, 0x68 };
char vg_9A[] PROGMEM = { 0x00, 0x02,0x85,0x96,0xB6,0xC5, 0x40, 0x42,0xCD };
char vg_9B[] PROGMEM = { 0x03,0x92,0xD2, 0x03,0x84,0x95,0xD5, 0x30,0xBF };
char vg_9C[] PROGMEM = { 0x03,0xA3, 0x06,0xC6,0xD5, 0x11,0xA0,0xB0,0xC1,0xC2, 0x11,0x9E };
char vg_9D[] PROGMEM = { 0x00,0x81,0xA3,0xC1, 0x04,0xC4, 0x06,0xC6, 0x12, 0x23,0xA7,
                         0x32, 0x40,0xC9 };
char vg_9E[] PROGMEM = { 0x00,0xB0,0xC1,0xC2, 0x00,0x87, 0x03,0xB3,0xC2, 0x54,0xF4,
                         0x63,0xE6,0xF7, 0xFF };
char vg_9F[] PROGMEM = { 0x06,0x97,0xA7,0xB6, 0x23,0xC3, 0x31,0xC0,0xD0,0xE1, 0x31,0xBE };
char vg_A0[] PROGMEM = { 0x05,0x96,0xB6,0xC5,0xD6, 0x05,0x94,0xC4, 0x12,0xB2,0xC3,0xC5,
                         0x20,0xC8 };
char vg_A1[] PROGMEM = { 0x12,0xA2,0xA6, 0x16,0xB6, 0x20,0xC8 };
char vg_A2[] PROGMEM = { 0x04,0x93,0xB3,0xC4,0xC5, 0x04,0x85,0x96,0xB6,0xC5, 0x21,0xC9 };
char vg_A3[] PROGMEM = { 0x03,0x85,0x96,0xB6,0xC5,0xD6, 0x21,0xC1, 0x43,0xCD };
char vg_A4[] PROGMEM = { 0x01,0x90,0xA0,0xB1,0xC1,0xD0, 0x03,0x86, 0x04,0x93,0xB3,0xC4,0xCE };
char vg_A5[] PROGMEM = { 0x00,0xC0, 0x02,0xC6, 0x02,0x86, 0x42,0xCE };
char vg_A6[] PROGMEM = { 0x11,0xA0,0xC0,0xC3, 0x11,0x92,0xA3,0xD3, 0x15,0xDD };
char vg_A7[] PROGMEM = { 0x11,0xA0,0xB0,0xC1,0xC2, 0x11,0x92,0xA3,0xB3,0xC2, 0x15,0xCD };
char vg_A8[] PROGMEM = { 0x15,0xA6,0xC6,0xD5, 0x15,0xB3, 0x30, 0x32,0xBB };
char vg_A9[] PROGMEM = { 0x03,0xC3, 0x03,0x8D };
char vg_AA[] PROGMEM = { 0x03,0xC3,0xCD };
char vg_AB[] PROGMEM = { 0x00,0x82, 0x05,0xD0, 0x34,0xC3,0xD3,0xE4, 0x46,0xE4, 0x46,0xC7,0xEF };
char vg_AC[] PROGMEM = { 0x00,0x82, 0x05,0xD0, 0x44,0xE2,0xE7, 0x44,0xC5,0xED };
char vg_AD[] PROGMEM = { 0x13,0xA2,0xB3,0xB5, 0x13,0xB5, 0x13,0xB3, 0x13,0x95,0xA6,0xB5,
                         0x14,0xB4, 0x15,0xB3, 0x15,0xB5, 0x20, 0x22,0xAE };
char vg_AE[] PROGMEM = { 0x03,0xA5, 0x03,0xA1, 0x43,0xE5, 0x43,0xE9 };
char vg_AF[] PROGMEM = { 0x01,0xA3, 0x05,0xA3, 0x41,0xE3, 0x45,0xEB };
char vg_B0[] PROGMEM = { 0x01, 0x03, 0x05, 0x07, 0x20, 0x22, 0x24, 0x26, 0x41, 0x43, 0x45,
                         0x47, 0x60, 0x62, 0x64, 0x6E };
char vg_B1[] PROGMEM = { 0x01,0xE7,0xF6, 0x01,0x90,0xF6, 0x03,0xC7,0xF4, 0x03,0xB0,0xF4,
                         0x05,0xA7,0xF2, 0x05,0xD0,0xF2, 0x07,0xF8 };
char vg_B2[] PROGMEM = { 0x01,0x91,0xA2,0xB2,0xC3,0xD3,0xE4,0xF4, 0x03,0x93,0xA4,0xB4,0xC5,0xD5,0xE6,0xF6,
                         0x05,0x95,0xA6,0xB6,0xC7,0xD7,0xE6, 0x07,0x97,0xA6, 0x11,0xA0,0xB0,0xC1,0xD1,0xE2,0xF2,
                         0x13,0xA2, 0x15,0xA4, 0x32,0xC1, 0x34,0xC3, 0x36,0xC5, 0x51,0xE0,0xF0,
                         0x53,0xE2, 0x55,0xEC };
char vg_B3[] PROGMEM = { 0x30,0xBF };
char vg_B4[] PROGMEM = { 0x04,0xB4, 0x30,0xBF };
char vg_B5[] PROGMEM = { 0x02,0xB2, 0x04,0xB4, 0x30,0xBF };
char vg_B6[] PROGMEM = { 0x04,0xB4, 0x30,0xB7, 0x60,0xEF };
char vg_B7[] PROGMEM = { 0x04,0xE4,0xE7, 0x34,0xBF };
char vg_B8[] PROGMEM = { 0x02,0xB2,0xB7, 0x04,0xBC };
char vg_B9[] PROGMEM = { 0x02,0xB2, 0x04,0xB4,0xB7, 0x30,0xB2, 0x60,0xEF };
char vg_BA[] PROGMEM = { 0x30,0xB7, 0x60,0xEF };
char vg_BB[] PROGMEM = { 0x02,0xE2,0xE7, 0x04,0xB4,0xBF };
char vg_BC[] PROGMEM = { 0x02,0xB2, 0x04,0xE4, 0x30,0xB2, 0x60,0xEC };
char vg_BD[] PROGMEM = { 0x04,0xE4, 0x30,0xB4, 0x60,0xEC };
char vg_BE[] PROGMEM = { 0x02,0xB2, 0x04,0xB4, 0x30,0xBC };
char vg_BF[] PROGMEM = { 0x04,0xB4,0xBF };
char vg_C0[] PROGMEM = { 0x30,0xB4,0xFC };
char vg_C1[] PROGMEM = { 0x04,0xF4, 0x30,0xBC };
char vg_C2[] PROGMEM = { 0x04,0xF4, 0x34,0xBF };
char vg_C3[] PROGMEM = { 0x30,0xB7, 0x34,0xFC };
char vg_C4[] PROGMEM = { 0x04,0xFC };
char vg_C5[] PROGMEM = { 0x04,0xF4, 0x30,0xBF };
char vg_C6[] PROGMEM = { 0x30,0xB7, 0x32,0xF2, 0x34,0xFC };
char vg_C7[] PROGMEM = { 0x30,0xB7, 0x60,0xE7, 0x64,0xFC };
char vg_C8[] PROGMEM = { 0x30,0xB4,0xF4, 0x60,0xE2,0xFA };
char vg_C9[] PROGMEM = { 0x32,0xF2, 0x32,0xB7, 0x64,0xF4, 0x64,0xEF };
char vg_CA[] PROGMEM = { 0x02,0xB2, 0x04,0xF4, 0x30,0xB2, 0x60,0xE2,0xFA };
char vg_CB[] PROGMEM = { 0x02,0xF2, 0x04,0xB4,0xB7, 0x64,0xF4, 0x64,0xEF };
char vg_CC[] PROGMEM = { 0x30,0xB7, 0x60,0xE2,0xF2, 0x64,0xF4, 0x64,0xEF };
char vg_CD[] PROGMEM = { 0x02,0xF2, 0x04,0xFC };
char vg_CE[] PROGMEM = { 0x02,0xB2, 0x04,0xB4,0xB7, 0x30,0xB2, 0x60,0xE2,0xF2, 0x64,0xF4,
                         0x64,0xEF };
char vg_CF[] PROGMEM = { 0x02,0xF2, 0x04,0xF4, 0x40,0xCA };
char vg_D0[] PROGMEM = { 0x04,0xF4, 0x30,0xB4, 0x60,0xEC };
char vg_D1[] PROGMEM = { 0x02,0xF2, 0x04,0xF4, 0x34,0xBF };
char vg_D2[] PROGMEM = { 0x04,0xF4, 0x34,0xB7, 0x64,0xEF };
char vg_D3[] PROGMEM = { 0x30,0xB4,0xF4, 0x60,0xEC };
char vg_D4[] PROGMEM = { 0x30,0xB4,0xF4, 0x32,0xFA };
char vg_D5[] PROGMEM = { 0x32,0xF2, 0x32,0xB7, 0x34,0xFC };
char vg_D6[] PROGMEM = { 0x34,0xF4, 0x34,0xB7, 0x64,0xEF };
char vg_D7[] PROGMEM = { 0x04,0xF4, 0x30,0xB7, 0x60,0xEF };
char vg_D8[] PROGMEM = { 0x02,0xF2, 0x04,0xF4, 0x30,0xBF };
char vg_D9[] PROGMEM = { 0x04,0xB4, 0x30,0xBC };
char vg_DA[] PROGMEM = { 0x34,0xF4, 0x34,0xBF };
char vg_DB[] PROGMEM = { 0x00,0xF0,0xF7, 0x00,0x87,0xF7, 0x01,0xF1, 0x02,0xF2, 0x03,0xF3,
                         0x04,0xF4, 0x05,0xF5, 0x06,0xF6, 0x10,0x97, 0x20,0xA7, 0x30,0xB7,
                         0x40,0xC7, 0x50,0xD7, 0x60,0xEF };
char vg_DC[] PROGMEM = { 0x04,0xF4,0xF7, 0x04,0x87,0xF7, 0x05,0xF5, 0x06,0xF6, 0x14,0x97,
                         0x24,0xA7, 0x34,0xB7, 0x44,0xC7, 0x54,0xD7, 0x64,0xEF };
char vg_DD[] PROGMEM = { 0x00,0xB0,0xB7, 0x00,0x87,0xB7, 0x01,0xB1, 0x02,0xB2, 0x03,0xB3,
                         0x04,0xB4, 0x05,0xB5, 0x06,0xB6, 0x10,0x97, 0x20,0xAF };
char vg_DE[] PROGMEM = { 0x40,0xF0,0xF7, 0x40,0xC7,0xF7, 0x41,0xF1, 0x42,0xF2, 0x43,0xF3,
                         0x44,0xF4, 0x45,0xF5, 0x46,0xF6, 0x50,0xD7, 0x60,0xEF };
char vg_DF[] PROGMEM = { 0x00,0xF0,0xF3, 0x00,0x83,0xF3, 0x01,0xF1, 0x02,0xF2, 0x10,0x93,
                         0x20,0xA3, 0x30,0xB3, 0x40,0xC3, 0x50,0xD3, 0x60,0xEB };
char vg_E0[] PROGMEM = { 0x03,0x92,0xA2,0xB3,0xC3,0xD2, 0x03,0x85,0x96,0xA6,0xB5,0xC5,0xD6,
                         0x33,0xBD };
char vg_E1[] PROGMEM = { 0x02,0x91,0xB1,0xC2, 0x02,0x87, 0x03,0xB3,0xC4, 0x05,0xB5,0xC4,
                         0x33,0xCA };
char vg_E2[] PROGMEM = { 0x01,0xC1,0xC2, 0x01,0x8E };
char vg_E3[] PROGMEM = { 0x02,0xD2, 0x12,0x96, 0x42,0xCE };
char vg_E4[] PROGMEM = { 0x00,0xC0,0xC1, 0x00,0x81,0xA3, 0x05,0xA3, 0x05,0x86,0xC6,
                         0x45,0xCE };
char vg_E5[] PROGMEM = { 0x03,0x92,0xD2, 0x03,0x85,0x96,0xA6,0xB5, 0x32,0xBD };
char vg_E6[] PROGMEM = { 0x07,0xA5,0xC5,0xD4, 0x11,0x94,0xA5, 0x51,0xDC };
char vg_E7[] PROGMEM = { 0x02,0x91,0xA1,0xB2,0xD2,0xE1, 0x32,0xBE };
char vg_E8[] PROGMEM = { 0x03,0x92,0xB2,0xC3,0xC4, 0x03,0x84,0x95,0xB5,0xC4, 0x10,0xB0,
                         0x17,0xB7, 0x20,0xAF };
char vg_E9[] PROGMEM = { 0x02,0xA0,0xB0,0xD2,0xD4, 0x02,0x84,0xA6,0xB6,0xD4, 0x03,0xDB };
char vg_EA[] PROGMEM = { 0x02,0xA0,0xB0,0xD2,0xD3, 0x02,0x83,0x94,0x96, 0x06,0x96,
                         0x44,0xD3, 0x44,0xC6,0xDE };
char vg_EB[] PROGMEM = { 0x04,0x93,0xC3, 0x04,0x85,0x96,0xB6,0xC5, 0x31,0xC2,0xC5,
                         0x31,0xC0,0xD8 };
char vg_EC[] PROGMEM = { 0x03,0x92,0xA2,0xB3,0xC2,0xD2,0xE3,0xE4, 0x03,0x84,0x95,0xA5,0xB4,0xC5,0xD5,0xE4,
                         0x33,0xBC };
char vg_ED[] PROGMEM = { 0x02,0x91,0xD1,0xE2,0xE4, 0x02,0x84,0x95,0xD5,0xE4, 0x06,0xE8 };
char vg_EE[] PROGMEM = { 0x02,0xA0,0xB0, 0x02,0x84,0xA6,0xB6, 0x03,0xBB };
char vg_EF[] PROGMEM = { 0x01,0x90,0xB0,0xC1,0xC6, 0x01,0x8E };
char vg_F0[] PROGMEM = { 0x11,0xD1, 0x13,0xD3, 0x15,0xDD };
char vg_F1[] PROGMEM = { 0x12,0xD2, 0x16,0xD6, 0x30,0xBC };
char vg_F2[] PROGMEM = { 0x06,0xC6, 0x10,0xB2, 0x14,0xBA };
char vg_F3[] PROGMEM = { 0x06,0xC6, 0x12,0xB4, 0x12,0xB8 };
char vg_F4[] PROGMEM = { 0x31,0xC0,0xD0,0xE1,0xE2, 0x31,0xBF };
char vg_F5[] PROGMEM = { 0x05,0x86,0x97,0xA7,0xB6, 0x30,0xBE };
char vg_F6[] PROGMEM = { 0x13,0xD3, 0x30,0xB1, 0x35,0xBE };
char vg_F7[] PROGMEM = { 0x02,0x91,0xA1,0xB2,0xC2,0xD1, 0x05,0x94,0xA4,0xB5,0xC5,0xDC };
char vg_F8[] PROGMEM = { 0x11,0xA0,0xB0,0xC1,0xC2, 0x11,0x92,0xA3,0xB3,0xCA };
char vg_F9[] PROGMEM = { 0x33,0xBC };
char vg_FA[] PROGMEM = { 0x3C };
char vg_FB[] PROGMEM = { 0x15,0xB7,0xC7, 0x40,0xE0, 0x40,0xCF };
char vg_FC[] PROGMEM = { 0x00,0x91,0xA0,0xB0,0xC1,0xC4, 0x11,0x9C };
char vg_FD[] PROGMEM = { 0x01,0x90,0xA0,0xB1, 0x04,0xB1, 0x04,0xBC };
char vg_FE[] PROGMEM = { 0x22,0xC4, 0x22,0xC2,0xC5, 0x22,0xA5,0xC3, 0x23,0xC5, 0x23,0xC3,
                         0x24,0xC2, 0x24,0xC4, 0x25,0xC5, 0x32,0xBD };
char vg_FF[] PROGMEM = { 0x01,0xD1,0xD6, 0x01,0x86,0xDE };

//
// Table of pointers to the character strokes
//
char *vgen[256] PROGMEM = {
   &vg_00[0],
   &vg_01[0],
   &vg_02[0],
   &vg_03[0],
   &vg_04[0],
   &vg_05[0],
   &vg_06[0],
   &vg_07[0],
   &vg_08[0],
   &vg_09[0],
   &vg_0A[0],
   &vg_0B[0],
   &vg_0C[0],
   &vg_0D[0],
   &vg_0E[0],
   &vg_0F[0],
   &vg_10[0],
   &vg_11[0],
   &vg_12[0],
   &vg_13[0],
   &vg_14[0],
   &vg_15[0],
   &vg_16[0],
   &vg_17[0],
   &vg_18[0],
   &vg_19[0],
   &vg_1A[0],
   &vg_1B[0],
   &vg_1C[0],
   &vg_1D[0],
   &vg_1E[0],
   &vg_1F[0],
   &vg_20[0],
   &vg_21[0],
   &vg_22[0],
   &vg_23[0],
   &vg_24[0],
   &vg_25[0],
   &vg_26[0],
   &vg_27[0],
   &vg_28[0],
   &vg_29[0],
   &vg_2A[0],
   &vg_2B[0],
   &vg_2C[0],
   &vg_2D[0],
   &vg_2E[0],
   &vg_2F[0],
   &vg_30[0],
   &vg_31[0],
   &vg_32[0],
   &vg_33[0],
   &vg_34[0],
   &vg_35[0],
   &vg_36[0],
   &vg_37[0],
   &vg_38[0],
   &vg_39[0],
   &vg_3A[0],
   &vg_3B[0],
   &vg_3C[0],
   &vg_3D[0],
   &vg_3E[0],
   &vg_3F[0],
   &vg_40[0],
   &vg_41[0],
   &vg_42[0],
   &vg_43[0],
   &vg_44[0],
   &vg_45[0],
   &vg_46[0],
   &vg_47[0],
   &vg_48[0],
   &vg_49[0],
   &vg_4A[0],
   &vg_4B[0],
   &vg_4C[0],
   &vg_4D[0],
   &vg_4E[0],
   &vg_4F[0],
   &vg_50[0],
   &vg_51[0],
   &vg_52[0],
   &vg_53[0],
   &vg_54[0],
   &vg_55[0],
   &vg_56[0],
   &vg_57[0],
   &vg_58[0],
   &vg_59[0],
   &vg_5A[0],
   &vg_5B[0],
   &vg_5C[0],
   &vg_5D[0],
   &vg_5E[0],
   &vg_5F[0],
   &vg_60[0],
   &vg_61[0],
   &vg_62[0],
   &vg_63[0],
   &vg_64[0],
   &vg_65[0],
   &vg_66[0],
   &vg_67[0],
   &vg_68[0],
   &vg_69[0],
   &vg_6A[0],
   &vg_6B[0],
   &vg_6C[0],
   &vg_6D[0],
   &vg_6E[0],
   &vg_6F[0],
   &vg_70[0],
   &vg_71[0],
   &vg_72[0],
   &vg_73[0],
   &vg_74[0],
   &vg_75[0],
   &vg_76[0],
   &vg_77[0],
   &vg_78[0],
   &vg_79[0],
   &vg_7A[0],
   &vg_7B[0],
   &vg_7C[0],
   &vg_7D[0],
   &vg_7E[0],
   &vg_7F[0],
   &vg_80[0],
   &vg_81[0],
   &vg_82[0],
   &vg_83[0],
   &vg_84[0],
   &vg_85[0],
   &vg_86[0],
   &vg_87[0],
   &vg_88[0],
   &vg_89[0],
   &vg_8A[0],
   &vg_8B[0],
   &vg_8C[0],
   &vg_8D[0],
   &vg_8E[0],
   &vg_8F[0],
   &vg_90[0],
   &vg_91[0],
   &vg_92[0],
   &vg_93[0],
   &vg_94[0],
   &vg_95[0],
   &vg_96[0],
   &vg_97[0],
   &vg_98[0],
   &vg_99[0],
   &vg_9A[0],
   &vg_9B[0],
   &vg_9C[0],
   &vg_9D[0],
   &vg_9E[0],
   &vg_9F[0],
   &vg_A0[0],
   &vg_A1[0],
   &vg_A2[0],
   &vg_A3[0],
   &vg_A4[0],
   &vg_A5[0],
   &vg_A6[0],
   &vg_A7[0],
   &vg_A8[0],
   &vg_A9[0],
   &vg_AA[0],
   &vg_AB[0],
   &vg_AC[0],
   &vg_AD[0],
   &vg_AE[0],
   &vg_AF[0],
   &vg_B0[0],
   &vg_B1[0],
   &vg_B2[0],
   &vg_B3[0],
   &vg_B4[0],
   &vg_B5[0],
   &vg_B6[0],
   &vg_B7[0],
   &vg_B8[0],
   &vg_B9[0],
   &vg_BA[0],
   &vg_BB[0],
   &vg_BC[0],
   &vg_BD[0],
   &vg_BE[0],
   &vg_BF[0],
   &vg_C0[0],
   &vg_C1[0],
   &vg_C2[0],
   &vg_C3[0],
   &vg_C4[0],
   &vg_C5[0],
   &vg_C6[0],
   &vg_C7[0],
   &vg_C8[0],
   &vg_C9[0],
   &vg_CA[0],
   &vg_CB[0],
   &vg_CC[0],
   &vg_CD[0],
   &vg_CE[0],
   &vg_CF[0],
   &vg_D0[0],
   &vg_D1[0],
   &vg_D2[0],
   &vg_D3[0],
   &vg_D4[0],
   &vg_D5[0],
   &vg_D6[0],
   &vg_D7[0],
   &vg_D8[0],
   &vg_D9[0],
   &vg_DA[0],
   &vg_DB[0],
   &vg_DC[0],
   &vg_DD[0],
   &vg_DE[0],
   &vg_DF[0],
   &vg_E0[0],
   &vg_E1[0],
   &vg_E2[0],
   &vg_E3[0],
   &vg_E4[0],
   &vg_E5[0],
   &vg_E6[0],
   &vg_E7[0],
   &vg_E8[0],
   &vg_E9[0],
   &vg_EA[0],
   &vg_EB[0],
   &vg_EC[0],
   &vg_ED[0],
   &vg_EE[0],
   &vg_EF[0],
   &vg_F0[0],
   &vg_F1[0],
   &vg_F2[0],
   &vg_F3[0],
   &vg_F4[0],
   &vg_F5[0],
   &vg_F6[0],
   &vg_F7[0],
   &vg_F8[0],
   &vg_F9[0],
   &vg_FA[0],
   &vg_FB[0],
   &vg_FC[0],
   &vg_FD[0],
   &vg_FE[0],
   &vg_FF[0]
};

#define VCHAR_W  8 // elemental width and height of character pattern 
#define VCHAR_H  8 
u08 vchar_inited;

// vector character attributes
// set generally by function calls

signed char VCharScaleX;
signed char VCharScaleY;

int VCharHeight;     // character height computed
int VCharWidth;      // character width  computed

signed char vchar_slant[8];  // x offsets for each row to slant characters

int VCharTable;


void vchar_init(void) 
{
   vchar_inited = 1;

   viewport_init();
   vchar_set_fontsize(8,8);
   vchar_set_thickness(1,1);
   vchar_set_spacing(0,0);
   vchar_set_slant(0);

   lcd_setxy(0,0);
}


void vchar_set_fontsize(u08 scaleX, u08 scaleY)
{
   if(vchar_inited == 0) vchar_init();  // a little idiot proofing

   VCharHeight = scaleY;
   VCharWidth  = scaleX;
}
   

void vchar_set_thickness(u08 thick_x, u08 thick_y)
{ 
   if(vchar_inited == 0) vchar_init();  // a little idiot proofing

   VCharThicknessX = thick_x;
   VCharThicknessY = thick_y;
}


void vchar_set_spacing(u08 space_x, u08 space_y)
{ 
   if(vchar_inited == 0) vchar_init();  // a little idiot proofing

   VCharSpaceX = space_x;
   VCharSpaceY = space_y;
}

void vchar_set_slant(int degrees)
{
long sin_a, cos_a;
long tan_a;
int i;

   if(degrees < 0) {
      sin_a = sin360(0-degrees);
      cos_a = cos360(0-degrees);
      sin_a = 0 - sin_a;
   }
   else {
      sin_a = sin360(degrees);
      cos_a = cos360(degrees);
   }
   sin_a *= 256L;
   tan_a = sin_a / cos_a;
    
   sin_a = 0;
   for(i=VCHAR_H-1; i>=0; i--) {
      vchar_slant[i] = sin_a / 256L;
      sin_a += tan_a;
   }
}

void vchar_erase(COORD col, COORD row)
{
u08 i;
u08 cur;

cur = erase_cursor();

   invert_colors();

   for(i=0; i<VCharHeight+VCharSpaceY; i++) {
      hline(row+i, col, col+VCharWidth+VCharSpaceX-1);
   }

   invert_colors();

if(cur) show_cursor();
   return;
}


void vchar_char(int xoffset,int yoffset,u08 c)  // draw a vector character
{ 
int x1,y1, x2,y2, x,y;  
u08 VByte;
u16 VIndex;  // char gen table offset
u08 cur;
int xslant;

cur = erase_cursor();

   if(vchar_inited == 0) vchar_init();  // a little idiot proofing

   if(printf_flags & VCHAR_ERASE) {
       vchar_erase(xoffset, yoffset);
   }

   // loops allow overprinting of vector character with x,y
   // offsets, default is thickness 1 in x and y
   // result is character is drawn one time
   x2 = y2 = 0;

   for(y=yoffset;y<yoffset+VCharThicknessY;y++) {
      for(x=xoffset;x<xoffset+VCharThicknessX;x++) {
         VIndex = pgm_read_word_near(&vgen[c]);  // pointer to stroke for the char
  
         while(1) {  // draw the character strokes
            VByte = pgm_read_byte_near(VIndex);
            if(VByte == 0xFF) break;
            ++VIndex;

            x1 = (VByte >> 4) & 0x07;
            y1 = (VByte & 0x07);
            xslant = (((int)vchar_slant[y1]) * VCharWidth) / VCHAR_W;

            x1 *= VCharWidth;
            if((c >= 0xB0) && (c <= 0xDF)) {  // make sure line drawing chars touch
               if(((VByte>>4) & 0x07) == (VCHAR_W-1)) x1 += (VCharWidth-1);
            }
            x1 /= VCHAR_W;

            y1 *= VCharHeight;
            if((c >= 0xB0) && (c <= 0xDF)) { // make sure line drawing chars touch
               if((VByte & 0x07) == (VCHAR_H-1)) y1 += (VCharHeight-1);
            }
            y1 /= VCHAR_H;
   
            if(rotate & ROT_CHAR_HORIZ) {
               x1 = (VCharWidth-1) - x1;
               xslant = 0 - xslant;
            }
            if(rotate & ROT_CHAR_VERT) y1 = (VCharHeight-1) - y1;

            x1 += xslant;

            if((VByte & 0x80) == 0x00) {  // move to point and draw a dot
               x2 = x1;   // we do dots as a single point line
               y2 = y1;
            }

            if(rotate & ROT_CHAR_90) {
               clipped_line(y1+x,x1+y, y2+x,x2+y);
            }
            else {
               clipped_line(x1+x,y1+y, x2+x,y2+y);
            }

            if(VByte & 0x08) break;  // end of list

            x2 = x1;  // prepare for next stroke in the character
            y2 = y1;
         }
      } // end for x
   } // end for y 
if(cur) show_cursor();
}  




// PRELIM support of stdout using stdio.h 

static int vchar_putchar(char c, FILE *stream); // fwd declare


// macro FDEV_SETUP_STREAM provided by stdio.h
// put,get,rwflag

static FILE vchar_stdout = FDEV_SETUP_STREAM(vchar_putchar, NULL,
                                             _FDEV_SETUP_WRITE);


void vchar_set_stdout(void)
{
   stdout = &vchar_stdout;   
   printf_flags = 0xFFFF;
}


static int vchar_putchar(char c, FILE *stream)
{
u08 cur;
COORD h, w;

cur = erase_cursor();

   if(printf_flags & VCHAR_COMPAT) {  // force char sizes to match bitmapped chars
      vchar_set_fontsize(CHAR_WIDTH*char_size, CHAR_HEIGHT*char_size);
      vchar_set_thickness(char_size, char_size);
      vchar_set_spacing((CHAR_WIDTH-VCHAR_W)*char_size, (CHAR_HEIGHT-VCHAR_H)*char_size); 
   }

   if(rotate & ROT_CHAR_90) {
      w = (VCharHeight+VCharSpaceX);
      h = (VCharWidth+VCharSpaceY);
   }
   else {
      w = (VCharWidth+VCharSpaceX);
      h = (VCharHeight+VCharSpaceY);
   }

   if((printf_flags & PRINTF_BEL) && (c == '\a')) {  // beep
      beep(200,2000); 
   }
   else if((printf_flags & PRINTF_BS) && (c == '\b')) {  // back space
      if(lcd_col < w) lcd_col = 0;
      else lcd_col -= w;
   }
   else if((printf_flags & PRINTF_FF) && (c == '\f')) { // form feed
      lcd_col = lcd_row = 0;
   }
   else if((printf_flags & PRINTF_NL) && (c == '\n')) { // newline (CRLF)
      lcd_col = 0;
      lcd_row += h;
   }
   else if((printf_flags & PRINTF_CR) && (c == '\r')) { // carriage return
      lcd_col = 0;
   }
   else if((printf_flags & PRINTF_TAB) && (c == '\t')) {  //!!! how best to handle TAB?
      lcd_col += w;
   }
   else if((printf_flags & PRINTF_VT) && (c == '\v')) {  // vertical tab (line feed)
      lcd_row += h;
   }
   else { // output all other characters
      vchar_char(lcd_col, lcd_row, c);
      lcd_col += w;
   }

   if(lcd_col > (COLS-w)) {  // wrap to next line
      lcd_col = 0;
      lcd_row += h;
   } 
   
   if(lcd_row > (ROWS-h)) {  // scroll screen up
      if(printf_flags & PRINTF_SCROLL) {
         lcd_row -= h;
         lcd_scroll(h);
      }
      else lcd_row = 0;
   }

if(cur) show_cursor();
   return 0;
}


// output a text string
// does not use stdout
// mimics behavior of putchar except does not decode \n

void vchar_text(COORD col,COORD row,  char *s)
{
unsigned char c;
u08 cur;
COORD h,w;

cur = erase_cursor();

   if(printf_flags & VCHAR_COMPAT) {  // force char sizes to match bitmapped chars
      vchar_set_fontsize(CHAR_WIDTH*char_size, CHAR_HEIGHT*char_size);
      vchar_set_thickness(char_size, char_size);
      vchar_set_spacing((CHAR_WIDTH-VCHAR_W)*char_size, (CHAR_HEIGHT-VCHAR_H)*char_size); 
   }

   if(rotate & ROT_CHAR_90) {
      w = (VCharHeight+VCharSpaceX);
      h = (VCharWidth+VCharSpaceY);
   }
   else {
      w = (VCharWidth+VCharSpaceX);
      h = (VCharHeight+VCharSpaceY);
   }

   while((c=*s++)) {
      vchar_char(col, row, c);

      if(rotate & ROT_STRING_VERT) {  /* draw strings vertically */
         if(rotate & ROT_STRING_HORIZ) row -= h;
         else row += h;
         if(row >= ROWS) break;   /* !!! clipping */
      }
      else { /* draw strings horizontally */
         if(rotate & ROT_STRING_HORIZ) col -= w;
         else col += w;
         if(col >= COLS) break;   /* !!! clipping */
      }
   }
if(cur) show_cursor();
}



void vchar_textPM(COORD col,COORD row,  PGM_P s)
{
unsigned char c;
u08 i;
u08 cur;
COORD h,w;

cur = erase_cursor();

   if(printf_flags & VCHAR_COMPAT) {  // force char sizes to match bitmapped chars
      vchar_set_fontsize(CHAR_WIDTH*char_size, CHAR_HEIGHT*char_size);
      vchar_set_thickness(char_size, char_size);
      vchar_set_spacing((CHAR_WIDTH-VCHAR_W)*char_size, (CHAR_HEIGHT-VCHAR_H)*char_size); 
   }

   if(rotate & ROT_CHAR_90) {
      w = (VCharHeight+VCharSpaceX);
      h = (VCharWidth+VCharSpaceY);
   }
   else {
      w = (VCharWidth+VCharSpaceX);
      h = (VCharHeight+VCharSpaceY);
   }

   i = 0;
   while(1) {
      c = pgm_read_byte(s+i);
      if(c == 0) break;
      ++i;

      vchar_char(col, row, c);

      if(rotate & ROT_STRING_VERT) {  /* draw strings vertically */
         if(rotate & ROT_STRING_HORIZ) row -= h;
         else row += h;
         if(row >= ROWS) break;   /* !!! clipping */
      }
      else { /* draw strings horizontally */
         if(rotate & ROT_STRING_HORIZ) col -= w;
         else col += w;
         if(col >= COLS) break;   /* !!! clipping */
      }
   }
if(cur) show_cursor();
}

#ifdef VCHAR_DEMO

void show_vchar_set(u08 sx, u08 sy)
{
int c;
u08 ofs;
int chars_per_line;
int lines_per_screen;
int chars_per_screen;
int line_space;
int row;

   if(COLS > 128) ofs = 28;
   else ofs = 0;
   row = 0;

   line_space = (sy + CHAR_HEIGHT - 1) / CHAR_HEIGHT;
   line_space *= CHAR_HEIGHT;
   lines_per_screen = (64/line_space);
   chars_per_line = (128/sx);
   chars_per_screen = lines_per_screen * chars_per_line;

   vchar_init();
   vchar_set_fontsize(sx,sy);
//vchar_set_slant(30);

   for(c=0; c<256; c++) {
      if((c%chars_per_screen) == 0) {
         lcd_clear();
         row = 0-line_space;
      }

      if((c%chars_per_line) == 0) {
         row += line_space;
         if(ofs) {
            lcd_setxy(0,row);
            printf("%02X:", c);
         }
      }

      printf_flags &= (~VCHAR_ERASE);
      vchar_char(ofs+((c%chars_per_line)*sx),row, c);
      printf_flags |= (VCHAR_ERASE);

      if((c%chars_per_screen) == (chars_per_screen-1)) {
         wait_while_touched();
         wait_until_touched();
      }
   }
}

void show_huge_vchars()
{
u08 c;
#define C 32

   vchar_init();         /* vector LCD font init  */
   vchar_set_fontsize(C,C);

   lcd_clear();
   for(c=0; c<128; c++) {
      vchar_char((c%5)*C, (c/5)*C, c);
      if(c > 15) break;
   }
   wait_while_touched();
   wait_until_touched();
}


void vchar_demo(void)
{
u08 i;

   set_color(WHITE);
   set_bg(BLACK);
   lcd_clear();

   vchar_init();         /* vector LCD font init  */
   vchar_set_stdout();
   printf_flags &= (~VCHAR_COMPAT);   // don't force vchar cells to bitmapped char size

   vchar_set_fontsize(4,6);
VCharSpaceY = 2;
VCharSpaceX = 2;
   printf(PS("ABCDEFGHIJKLMNOPQRSTUVWXYZ\n"));
   printf(PS("01234567890 !@#$%%^&*()_+-=\n"));
   printf(PS("[]|\\:;""',.?/\n"));

   vchar_set_thickness(2,2);
   vchar_set_fontsize(12,12);
   VCharSpaceX = 4;
   printf(PS("ABCDEFGHI"));

//   delay_until_touched(2000);
wait_until_touched();
   wait_while_touched();

   for(i=1; i<6; i++) {
//while(0) {
     lcd_clear();
     vchar_set_thickness(i+1,i+1);
     vchar_set_fontsize(i*8,i*8);

     printf(PS("60%d"),i);
     delay_ms(1000);

#ifdef USER_INPUT
     if(get_touch(1)) break;
#endif
   }
   delay_ms(1000);

   lcd_set_stdout();    // make printf() use bitmapped chars
}

#endif  // VCHAR_DEMO
#endif  // VCHAR_CODE
